// settings, specific to the Sofle keyboard

// left-hand keys
// leftmost column (0, 12, 24, 36) skipped as they are used for modificators (esc, tab, shift)
#define KEYS_L 1  2  3  4  5 \
               13 14 15 16 17 \
               25 26 27 28 29 \
               37 38 39 40 41

// right-hand keys
#define KEYS_R 6  7  8  9  10 11 \
               18 19 20 21 22 23 \
               30 31 32 33 34 35 \
               44 45 46 47 48 49 // indexes 42 and 43 missing because they are reserved for encoders

// thumb keys
#define THUMBS 50 51 52 53 54 55 56 57 58 59

&led_strip {
    chain-length = <35>;
};

&left_encoder {
    resolution = <2>;
};