#include <behaviors.dtsi>
#include "../../include/layers.h"

sym {
    display-name = "sym";
    bindings = <
&none          &none          &none         &none         &none           &none                                         &none           &none           &none         &none           &none             &none
&trans         &none          &none         &none         &none           &kp DEL                                       &kp LBKT        &kp RBKT        &kp MINUS     &kp EQUAL       &none             &none
&trans         &kp LGUI       &kp LALT      &kp LCTRL     &kp LSHFT       &kp RET                                       &kp SQT         &kp RSHFT       &kp LPAR      &kp RPAR        &none             &none
&trans         &none          &none         &none         &none           &to HUB          &none          &none         &kp FSLH        &kp BSLH        &kp GRAVE     &none           &none             &none
                              &none         &none         &kp ESC         &kp SPACE        &lt SYM TAB    &kp RET       &rem            &kp DEL         &none         &none
    >;

    sensor-bindings = <&inc_dec_kp C_VOL_UP C_VOL_DN &inc_dec_kp PG_UP PG_DN>;
};