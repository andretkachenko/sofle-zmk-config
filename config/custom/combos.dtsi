#include <behaviors/num_word.dtsi>

#define COMBO(NAME, POS, BIND, TERM, IDLE) \
        NAME { \
            timeout-ms = <TERM>; \
            key-positions = <POS>; \
            bindings = <BIND>; \
            require-prior-idle-ms = <IDLE>; \
            slow-release; \
        };

#define SLOW(NAME, POS, BIND) COMBO(NAME, POS, BIND, 50, 100)
#define FAST(NAME, POS, BIND) COMBO(NAME, POS, BIND, 20, 200)

/ {
    combos {
        compatible = "zmk,combos";

        SLOW(combo_hub_mode, 28 41, &to HUB) // f + b -> hub layer
        SLOW(combo_mouse_mode, 29 30, &smart_mouse MSE) // g + h -> mouse layer
        SLOW(combo_numword, 17 29, &num_word NUM) // t + g -> num word
        SLOW(combo_navword, 16 28, &nav_word NAV) // r + f -> nav word

        FAST(combo_esc, 14 15, &kp ESC) // w + e -> esc
        FAST(combo_tab, 15 16, &kp TAB) // e + r -> tab
        FAST(combo_ret, 28 29, &kp RET) // f + g -> ret
        FAST(combo_dell, 16 17, &kp DEL) // r + t -> del
        FAST(combo_delr, 20 21, &kp DEL) // i + o -> del
        FAST(combo_bspc, 21 22, &kp BSPC) // o + p -> bspc
        FAST(combo_app, 46 47, &kp K_APP) // , + . -> application (context menu)
        FAST(combo_mute, 39 40, &kp F23) // c + v -> F23
        FAST(combo_deafen, 40 41, &kp F24) // v + b -> F24
        FAST(combo_cancel, 38 39, &kp K_CANCEL) // x + c -> cancel (to escape from sticky layers)
    };
};