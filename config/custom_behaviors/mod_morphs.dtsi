/ {
    behaviors {     
        rem: rem { // tap: backspace | shift + tap: delete
            compatible = "zmk,behavior-mod-morph";
            #binding-cells = <0>;
            bindings = <&kp BSPC>, <&kp DEL>;
            mods = <(MOD_LSFT|MOD_RSFT)>;
        };
    };
};