#include "layers/sofle/names.h"
#include "layouts/sofle.h"

#include <behaviors.dtsi>
#include <dt-bindings/zmk/bt.h>
#include <dt-bindings/zmk/keys.h>
#include <dt-bindings/zmk/ext_power.h>
#include <dt-bindings/zmk/rgb.h>
#include <dt-bindings/zmk/outputs.h>

#include "settings/overrides.dtsi"
#include "settings/sofle.dtsi"

#include "custom/hrm.dtsi"
#include "custom/behaviors.dtsi"
#include "custom/combos.dtsi"

#include "layers/sofle/base.dtsi"
#include "layers/sofle/num.dtsi"
#include "layers/sofle/nav.dtsi"
#include "layers/sofle/uni.dtsi"
#include "layers/sofle/fn.dtsi"
#include "layers/sofle/hub.dtsi"
#include "layers/sofle/mouse.dtsi"
#include "layers/sofle/sys.dtsi"